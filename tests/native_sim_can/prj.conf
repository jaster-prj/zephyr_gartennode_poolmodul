## CMakeLists.txt
```
cmake_minimum_required(VERSION 3.20.0)
find_package(Zephyr REQUIRED HINTS $ENV{ZEPHYR_BASE})
project(native_sim_can_udp_test)
target_sources(app PRIVATE src/main.c)
```

## Kconfig
```
mainmenu "Native simulator UDP-CAN test"
config TEST_CAN_NODE_ID
    int "Test CAN node identifier"
    range 1 127
    default 9
source "Kconfig.zephyr"
```

## prj.conf
```kconfig
CONFIG_CAN=y
CONFIG_CAN_NATIVE_UDP=y
CONFIG_LOG=y
```

## node_10.conf
```kconfig
CONFIG_TEST_CAN_NODE_ID=10
```

## node_9.conf
```kconfig
CONFIG_TEST_CAN_NODE_ID=9
```

## node_10.overlay
```dts
&can_udp0 {
    host = "127.0.0.1";
    port = <46101>;
    local-port = <46111>;
};
```

## node_9.overlay
```dts
&can_udp0 {
    host = "127.0.0.1";
    port = <46100>;
    local-port = <46110>;
};
```

## boards/native_sim.overlay
```dts
/ {
    chosen {
        zephyr,canbus = &can_udp0;
    };

    can_udp0: udp-can {
        compatible = "zephyr,native-linux-udp-can";
        host = "127.0.0.1";
        port = <46100>;
        local-port = <46110>;
        status = "okay";
    };
};
```

## src/main.c
```c
#include <zephyr/device.h>
#include <zephyr/drivers/can.h>
#include <zephyr/kernel.h>
#include <zephyr/sys/printk.h>

#define NODE_ID CONFIG_TEST_CAN_NODE_ID

static void on_frame(const struct device *dev, struct can_frame *frame, void *user_data)
{
    ARG_UNUSED(dev);
    ARG_UNUSED(user_data);
    if (frame->id == (0x100U + (NODE_ID == 9 ? 10U : 9U)) && frame->dlc == 1) {
        struct can_frame ack = {
            .id = 0x200U + NODE_ID,
            .dlc = 1,
            .data = {NODE_ID},
        };

        printk("received peer frame 0x%x; sending ACK 0x%x\n", frame->id, ack.id);
        if (can_send(dev, &ack, K_MSEC(100), NULL, NULL) != 0) {
            printk("CAN ACK send failed\n");
        }
    }
}

int main(void)
{
    const struct device *can_dev = DEVICE_DT_GET(DT_CHOSEN(zephyr_canbus));
    const struct can_filter filter = {.id = 0, .mask = 0};
    struct can_frame hello = {.id = 0x100U + NODE_ID, .dlc = 1};
    int ret;

    if (!device_is_ready(can_dev)) {
        printk("CAN device not ready\n");
        return 1;
    }
    ret = can_add_rx_filter(can_dev, on_frame, NULL, &filter);
    if (ret < 0) {
        printk("CAN RX filter failed: %d\n", ret);
        return 1;
    }
    ret = can_start(can_dev);
    if (ret != 0) {
        printk("CAN start failed: %d\n", ret);
        return 1;
    }
    hello.data[0] = NODE_ID;
    while (true) {
        ret = can_send(can_dev, &hello, K_MSEC(100), NULL, NULL);
        if (ret != 0) {
            printk("CAN hello send failed: %d\n", ret);
            return 1;
        }
        k_sleep(K_MSEC(50));
    }
    return 0;
}
```
